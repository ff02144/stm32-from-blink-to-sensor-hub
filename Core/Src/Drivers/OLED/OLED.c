#include "oled.h"
#include "main.h"  


void OLED_Init(void)
{
    HAL_Delay(100);
    OLED_WriteCmd(0xAE);
    OLED_WriteCmd(0xD5);
    OLED_WriteCmd(0x80);
    OLED_WriteCmd(0xA8);
    OLED_WriteCmd(0x3F);
    OLED_WriteCmd(0xD3);
    OLED_WriteCmd(0x00);
    OLED_WriteCmd(0x40);
    OLED_WriteCmd(0x8D);
    OLED_WriteCmd(0x14);
    OLED_WriteCmd(0x20);
    OLED_WriteCmd(0x00);
    OLED_WriteCmd(0xA1);
    OLED_WriteCmd(0xC8);
    OLED_WriteCmd(0xDA);
    OLED_WriteCmd(0x12);
    OLED_WriteCmd(0x81);
    OLED_WriteCmd(0xCF);
    OLED_WriteCmd(0xD9);
    OLED_WriteCmd(0xF1);
    OLED_WriteCmd(0xDB);
    OLED_WriteCmd(0x40);
    OLED_WriteCmd(0xA4);
    OLED_WriteCmd(0xA6);
    OLED_WriteCmd(0x2E);
    OLED_WriteCmd(0xAF);
}


void OLED_Clear(void)
{
    uint8_t zero[128] = {0};
    for (uint8_t page = 0; page < 8; page++)
    {
        OLED_WriteCmd(0xB0 + page);
        OLED_WriteCmd(0x00);
        OLED_WriteCmd(0x10);
        HAL_I2C_Mem_Write(&hi2c1, oled_addr << 1, 0x40, 1, zero, 128, 100);
    }
}


void OLED_WriteCmd(uint8_t cmd)
{
    HAL_I2C_Mem_Write(&hi2c1, oled_addr << 1, 0x00, 1, &cmd, 1, 100);
}

void OLED_WriteData(uint8_t *data, uint16_t len)
{
    HAL_I2C_Mem_Write(&hi2c1, oled_addr << 1, 0x40, 1, data, len, 100);
}


void OLED_WriteString(char *str)
{
    uint8_t x = 0;  // 水平位置（0~127）
    uint8_t y = 0;  // 頁面（0~7）

    while (*str)
    {
        if (*str=='\n')  // ASCII 碼 10
            {
                x = 0;          // X 回到最左邊
                y++;            // Y 往下移一行（頁面 +1）

                if (y>7)      // 超過最後一頁（第 7 頁）
                {
                    break;      // 寫滿了就停止（或你可以改成從頭覆蓋）
                }

                // 把硬體游標移動到新的 (x, y) 位置
                OLED_WriteCmd(0xB0+y);           // 設定頁面
                OLED_WriteCmd(0x00+(x&0x0F));  // 設定低 4 位列位址
                OLED_WriteCmd(0x10+((x>>4)&0x0F)); // 設定高 4 位列位址

                str++;  // 跳過 \n，繼續處理下一個字元
                continue;  // 回到 while 開頭
            }
    	// 只處理 ASCII 32~127
        if (*str<32||*str>127)
        {
            str++;
            continue;
        }

        // 設定游標位置（頁面 y，列 x）
        OLED_WriteCmd(0xB0+y);
        OLED_WriteCmd(0x00+(x&0x0F));
        OLED_WriteCmd(0x10+((x>>4)&0x0F));

        // 取得字型點陣（5 個位元組）
        const uint8_t *glyph=Font5x7[*str-32];
        // 寫入顯存（連續 5 個位元組）
        HAL_I2C_Mem_Write(&hi2c1,oled_addr<<1,0x40,1,(uint8_t*)glyph,5,100);

        x += 6;  // 每個字元佔 6 像素寬（5 點陣 + 1 間隔）
        if (x>128 - 6)  // 超過寬度就換行
        {
            x=0;
            y++;
            if (y>7) break;  // 超過頁面就停止
        }
        str++;
    }
}


const uint8_t Font5x7[96][5] = {
    {0x00,0x00,0x00,0x00,0x00}, // 32 空格
    {0x00,0x00,0x5F,0x00,0x00}, // 33 !
    {0x00,0x07,0x00,0x07,0x00}, // 34 "
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    {0x00,0x00,0x00,0x00,0x00}  // 127 DEL
};

// 顯示字串（使用 5x7 字型）
